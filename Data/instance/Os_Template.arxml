AUTOSAR XML (schema 00046)
package /AutosarConfigurator
  module config ArtiOs: implementation-config-variant=VARIANT-POST-BUILD, module-description=ArtiOs
