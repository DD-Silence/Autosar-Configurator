AUTOSAR XML (schema 00046)
package /AutosarConfigurator
  module config ComM: implementation-config-variant=VARIANT-POST-BUILD, module-description=ComM
