AUTOSAR XML (schema 00046)
package /AutosarConfigurator
  module config PduR: implementation-config-variant=VARIANT-POST-BUILD, module-description=PduR
