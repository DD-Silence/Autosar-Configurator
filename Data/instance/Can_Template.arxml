AUTOSAR XML (schema 00046)
package /AutosarConfigurator
  module config Can: implementation-config-variant=VARIANT-POST-BUILD, module-description=Can
