AUTOSAR XML (schema 00046)
package /AutosarConfigurator
  module config Dio: implementation-config-variant=VARIANT-POST-BUILD, module-description=Dio
