AUTOSAR XML (schema 00046)
package /AutosarConfigurator
  module config BswM: implementation-config-variant=VARIANT-POST-BUILD, module-description=BswM
