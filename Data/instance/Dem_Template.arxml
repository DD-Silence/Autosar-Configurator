AUTOSAR XML (schema 00046)
package /AutosarConfigurator
  module config Dem: implementation-config-variant=VARIANT-POST-BUILD, module-description=Dem
