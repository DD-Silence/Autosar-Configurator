AUTOSAR XML (schema 00046)
package /AutosarConfigurator
  module config CanIf: implementation-config-variant=VARIANT-POST-BUILD, module-description=CanIf
