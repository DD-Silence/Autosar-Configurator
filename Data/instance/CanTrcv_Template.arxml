AUTOSAR XML (schema 00046)
package /AutosarConfigurator
  module config CanTrcv: implementation-config-variant=VARIANT-POST-BUILD, module-description=CanTrcv
