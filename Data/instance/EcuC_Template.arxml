AUTOSAR XML (schema 00046)
package /AutosarConfigurator
  module config EcuC: implementation-config-variant=VARIANT-POST-BUILD, module-description=EcuC
