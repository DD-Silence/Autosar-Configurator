AUTOSAR XML (schema 00046)
package /AutosarConfigurator
  module config Fee: implementation-config-variant=VARIANT-POST-BUILD, module-description=Fee
