AUTOSAR XML (schema 00046)
package /AutosarConfigurator
  module config Cdd: implementation-config-variant=VARIANT-POST-BUILD, module-description=Cdd
