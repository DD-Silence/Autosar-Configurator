AUTOSAR XML (schema 00046)
package /AutosarConfigurator
  module config Adc: implementation-config-variant=VARIANT-POST-BUILD, module-description=Adc
