AUTOSAR XML (schema 00046)
package /AutosarConfigurator
  module config Dcm: implementation-config-variant=VARIANT-POST-BUILD, module-description=Dcm
