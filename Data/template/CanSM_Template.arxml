AUTOSAR XML (schema 00046)
package /AutosarConfigurator
  module config CanSM: implementation-config-variant=VARIANT-POST-BUILD, module-description=CanSM
