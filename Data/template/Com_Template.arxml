AUTOSAR XML (schema 00046)
package /AutosarConfigurator
  module config Com: implementation-config-variant=VARIANT-POST-BUILD, module-description=Com
