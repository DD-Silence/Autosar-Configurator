AUTOSAR XML (schema 00046)
package /AutosarConfigurator
  module config CanTp: implementation-config-variant=VARIANT-POST-BUILD, module-description=CanTp
