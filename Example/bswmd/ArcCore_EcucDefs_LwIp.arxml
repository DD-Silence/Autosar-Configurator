AUTOSAR XML (schema 4-0-3)
package /ArcCore/EcucDefs/Generic
  module definition LwIp [0..1]: variants pre-compile  # Configuration of the LwIp module
    container LwIpGeneral  # Configuration of DHCP and AutoIP options
      boolean LwIpDhcp: set at pre-compile, origin=ARC_ECUC, default-value=1  # This parameter indicates whether DHCP is used or not
      boolean LwIpAutoIp: set at pre-compile, origin=ARC_ECUC, default-value=0  # This parameter indicates whether AutoIP is used or not
      string LwIpIPAddress: set at pre-compile  # This parameter sets the IP address e.g. 192.168.0.5
      string LwIpNetmask: set at pre-compile  # This parameter sets the netmask e.g. 255.255.255.0
      string LwIpEthernetMacAddress: set at pre-compile  # This parameter sets the Ethernet MAC address. E.g. 00-00-00-00-00-06
      string LwIpGateway: set at pre-compile  # This parameter sets the gateway address e.g. 192.168.0.1
package /ArcCore/EcucDefs/Generic/Implementations
  bsw implementation LwIp: programming-language=C, sw-version=1.0.0, used-code-generator=generators::generic::LwIp::main, vendor-id=60, vendor-specific-module-def=LwIp
