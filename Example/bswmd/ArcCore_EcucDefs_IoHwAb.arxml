AUTOSAR XML (schema 4-0-3)
package /ArcCore/EcucDefs/Generic
  module definition IoHwAb [0..1]: variants pre-compile
    container ArcIoHwAbGeneral
      boolean ArcIoHwAbDevErrorDetect: default-value=1
      float ArcIoHwAbAnalogMaxVoltage: default-value=5.0
      boolean ArcIoHwAbUsePort: default-value=0
    container ArcIoHwAbDigitalSignal [1..*]
      enumeration ArcIoHwAbDigitalDefaultValue: {IOHWAB_HIGH, IOHWAB_LOW}, default-value=IOHWAB_LOW
      boolean ArcIoHwAbDigitalInverted: default-value=0
      enumeration ArcIoHwAbDigitalMethod: {IOHWAB_DIGITAL_READ, IOHWAB_DIGITAL_WRITE, IOHWAB_DIGITAL_WRITE_READBACK}, default-value=IOHWAB_DIGITAL_READ
      enumeration ArcIoHwAbDigitalType: {IOHWAB_DIO, IOHWAB_EXTERNAL_DEVICE}, default-value=IOHWAB_DIO
      reference ArcIoHwAbDioChannelRef [0..1]: destination=DioChannel
      reference ArcIoHwAbExternalDeviceDriverRef [0..1]: destination=ArcIoHwAbExternalDeviceDriver
      container ArcIoHwAbDigitalDiagnostic [1..*]
        enumeration ArcIoHwAbDigitalDiagnosticType: {IOHWAB_DIGITAL_GROUND, IOHWAB_DIGITAL_SUPPLY}, default-value=IOHWAB_DIGITAL_GROUND
        reference ArcIoHwAbDigitalDemEventParameterRef: destination=DemEventParameter
    container ArcIoHwAbExternalDeviceDriver [1..*]
package /ArcCore/EcucDefs/Generic/Implementations
  bsw implementation IoHwAb: programming-language=C, sw-version=1.0.0, used-code-generator=generators::generic::IoHwAb::main, vendor-id=60, ar-release-version=4.0.3, vendor-specific-module-def=IoHwAb
